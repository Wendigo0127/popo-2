## config/boards/shields/boboard/Kconfig.defconfig
```kconfig
# Copyright (c) 2022 The ZMK Contributors
# SPDX-License-Identifier: MIT

if SHIELD_POPO_LEFT

config ZMK_KEYBOARD_NAME
    default "POPO"
    
config ZMK_SPLIT_ROLE_CENTRAL
    default y

endif

if SHIELD_POPO_LEFT || SHIELD_POPO_RIGHT

config ZMK_SPLIT
    default y

endif
```

## config/boards/shields/boboard/Kconfig.shield
```kconfig
# Copyright (c) 2022 The ZMK Contributors
# SPDX-License-Identifier: MIT

config SHIELD_POPO_LEFT
    def_bool $(shields_list_contains,popo_left)

config SHIELD_POPO_RIGHT
    def_bool $(shields_list_contains,popo_right)
```
